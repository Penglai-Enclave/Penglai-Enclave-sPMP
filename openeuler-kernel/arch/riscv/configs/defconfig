## openeuler-kernel/drivers/net/ethernet/huawei/hinic/Kconfig
```kconfig
# SPDX-License-Identifier: GPL-2.0-only
#
# Huawei driver configuration
#

config HINIC
	tristate "Huawei Intelligent PCIE Network Interface Card"
	default n
	depends on PCI_MSI && NUMA && PCI_IOV && DCB && (X86 || ARM64)
	help
	  This driver supports HiNIC PCIE Ethernet cards.
	  To compile this driver as part of the kernel, choose Y here.
	  If unsure, choose N.
	  The default is N.
```

## openeuler-kernel/drivers/scsi/huawei/Kconfig
```kconfig
#
# Huawei driver configuration
#

config SCSI_HUAWEI_FC
	tristate "Huawei Fibre Channel Adapter"
	depends on PCI && SCSI
	depends on SCSI_FC_ATTRS
	depends on ARM64 || X86_64
	default m
	help
	  If you have a Fibre Channel PCI card belonging to this class, say Y.
	  Note that the answer to this question doesn't directly affect the
	  kernel: saying N will just cause the configurator to skip all
	  the questions about Huawei cards. If you say Y, you will be asked
	  for your specific card in the following questions.

if SCSI_HUAWEI_FC

source "drivers/scsi/huawei/hifc/Kconfig"

endif # SCSI_HUAWEI_FC
```

## openeuler-kernel/drivers/scsi/huawei/hifc/Kconfig
```kconfig
#
# Huawei driver configuration
#
config SCSI_FC_HIFC
	tristate "Huawei hifc Fibre Channel Support"
	default m
	depends on PCI && SCSI
	depends on SCSI_FC_ATTRS
	help
	This driver supports Huawei Fibre Channel  PCI and
	PCIE host adapters.
```

## openeuler-kernel/openEuler_riscv64_defconfig
```kconfig
# riscv Add for openEuler RISC-V
CONFIG_REISERFS_FS_XATTR=y
CONFIG_REISERFS_FS_SECURITY=y
CONFIG_EXT4_FS_SECURITY=y
CONFIG_BRIDGE=y
CONFIG_CMA=y
CONFIG_CMA_AREAS=7
CONFIG_DMA_CMA=y
CONFIG_CMA_SIZE_MBYTES=32
CONFIG_CMA_SIZE_SEL_MBYTES=y
CONFIG_CMA_ALIGNMENT=12
```

## openeuler-kernel/security/integrity/evm/Kconfig
```kconfig
# SPDX-License-Identifier: GPL-2.0-only
config EVM
	bool "EVM support"
	select KEYS
	select ENCRYPTED_KEYS
	select CRYPTO_HMAC
	select CRYPTO_SHA1
	select CRYPTO_HASH_INFO
	default n
	help
	  EVM protects a file's security extended attributes against
	  integrity attacks.

	  If you are unsure how to answer this question, answer N.

choice
	prompt "Default EVM hash algorithm"
	default EVM_DEFAULT_HASH_SHA256
	depends on EVM
	help
	   Select the default hash algorithm used for the HMAC.

	config EVM_DEFAULT_HASH_SHA1
		bool "SHA1 (default)"
		depends on CRYPTO_SHA1=y

	config EVM_DEFAULT_HASH_SHA256
		bool "SHA256"
		depends on CRYPTO_SHA256=y

	config EVM_DEFAULT_HASH_SHA512
		bool "SHA512"
		depends on CRYPTO_SHA512=y

	config EVM_DEFAULT_HASH_WP512
		bool "WP512"
		depends on CRYPTO_WP512=y
endchoice

config EVM_DEFAULT_HASH
	string
	depends on EVM
	default "sha1" if EVM_DEFAULT_HASH_SHA1
	default "sha256" if EVM_DEFAULT_HASH_SHA256
	default "sha512" if EVM_DEFAULT_HASH_SHA512
	default "wp512" if EVM_DEFAULT_HASH_WP512

config EVM_ATTR_FSUUID
	bool "FSUUID (version 2)"
	default y
	depends on EVM
	help
	  Include filesystem UUID for HMAC calculation.

	  Default value is 'selected', which is former version 2.
	  if 'not selected', it is former version 1

	  WARNING: changing the HMAC calculation method or adding
	  additional info to the calculation, requires existing EVM
	  labeled file systems to be relabeled.

config EVM_EXTRA_SMACK_XATTRS
	bool "Additional SMACK xattrs"
	depends on EVM && SECURITY_SMACK
	default n
	help
	  Include additional SMACK xattrs for HMAC calculation.

	  In addition to the original security xattrs (eg. security.selinux,
	  security.SMACK64, security.capability, and security.ima) included
	  in the HMAC calculation, enabling this option includes newly defined
	  Smack xattrs: security.SMACK64EXEC, security.SMACK64TRANSMUTE and
	  security.SMACK64MMAP.

	  WARNING: changing the HMAC calculation method or adding
	  additional info to the calculation, requires existing EVM
	  labeled file systems to be relabeled.

config EVM_ADD_XATTRS
	bool "Add additional EVM extended attributes at runtime"
	depends on EVM
	default n
	help
	  Allow userland to provide additional xattrs for HMAC calculation.

	  When this option is enabled, root can add additional xattrs to the
	  list used by EVM by writing them into
	  /sys/kernel/security/integrity/evm/evm_xattrs.

config EVM_LOAD_X509
	bool "Load an X509 certificate onto the '.evm' trusted keyring"
	depends on EVM && INTEGRITY_TRUSTED_KEYRING
	default n
	help
	   Load an X509 certificate onto the '.evm' trusted keyring.

	   This option enables X509 certificate loading from the kernel
	   onto the '.evm' trusted keyring.  A public key can be used to
	   verify EVM integrity starting from the 'init' process.

config EVM_X509_PATH
	string "EVM X509 certificate path"
	depends on EVM_LOAD_X509
	default "/etc/keys/x509_evm.der"
	help
	   This option defines X509 certificate path.
```
